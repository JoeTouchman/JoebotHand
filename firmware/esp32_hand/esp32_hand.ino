// Robotic Hand - 5 servo controller (ESP32-S3 port of firmware/uno_hand_v1)
//
// Wiring (servo signal wires):
//   Thumb  -> GPIO 4
//   Index  -> GPIO 5
//   Middle -> GPIO 6
//   Ring   -> GPIO 7
//   Pinky  -> GPIO 15
//
// Servo power: separate 5V supply (red -> 5V, brown -> GND), with the
// supply's GND tied to the ESP32's GND. Never the ESP32's 5V pin.
//
// Servos are driven directly with the core's LEDC PWM. Do not use
// ESP32Servo in this project: on the S3 (v3.2.1) it routes several
// servos to the same MCPWM output.
//
// LEDC budget: the S3 has 8 channels. 5 servos (ch 0-4, sharing one timer),
// the buzzer (ch 5) and the status LED (ch 6) use 7, leaving 1 spare.
// printChannelMap() lists them all at boot and flags any collision.

#include "esp32-hal-periman.h"
#include "soc/gpio_reg.h"
#include "soc/gpio_sig_map.h"
#include <WiFi.h>
#include <esp_wifi.h>
#include <LittleFS.h>
#include <AsyncUDP.h>
#include <esp_https_server.h>
#include <esp_http_server.h>
#include "certs.h"  // TLS certificate + key, generated by make_certs.sh

// --- buzzer ------------------------------------------------------------
// Passive piezo on GPIO 17, driven straight from LEDC on a channel we ask
// for by number: the S3 has 8 and the servos hold 0-4. The core picks the
// timer by frequency and resolution, so this 2 kHz / 10-bit channel never
// shares the servos' 50 Hz / 14-bit timer (printBuzzerInfo shows both).
//
// Retune the sounds here: {frequency in Hz, milliseconds}, hz 0 = silence.
struct Note { uint16_t hz; uint16_t ms; };
// A passive piezo is loudest at its resonance, usually near 4 kHz, and falls
// off steeply below it - so these sit high on purpose. Play B3 (sweep) and
// pick whichever step is loudest on your piezo, then tune these to match.
const Note BOOT_CHIRP[]  = {{3136, 70}, {4186, 110}};            // rising two-note
const Note DONE_BEEP[]   = {{4186, 70}, {0, 55}, {4186, 70}};    // quick double-beep
const Note CLIENT_BLIP[] = {{4186, 50}, {3136, 80}};             // falling: a phone connected
const Note SWEEP[]       = {{1000, 150}, {1500, 150}, {2000, 150}, {2500, 150}, {3000, 150},
                            {3500, 150}, {4000, 150}, {4500, 150}, {5000, 150}};

struct Sound { const char *name; const Note *notes; uint8_t count; };
const Sound SOUNDS[] = {
  {"boot", BOOT_CHIRP, sizeof(BOOT_CHIRP) / sizeof(Note)},
  {"done", DONE_BEEP, sizeof(DONE_BEEP) / sizeof(Note)},
  {"client", CLIENT_BLIP, sizeof(CLIENT_BLIP) / sizeof(Note)},
  {"sweep 1-5 kHz", SWEEP, sizeof(SWEEP) / sizeof(Note)},
};
const int NUM_SOUNDS = sizeof(SOUNDS) / sizeof(Sound);
const int SOUND_BOOT = 0, SOUND_DONE = 1, SOUND_CLIENT = 2;

const int BUZZER_PIN = 17;
const uint8_t BUZZER_CHANNEL = 5;     // asked for explicitly; servos take 0-4
const uint8_t BUZZER_RES = 10;
const uint32_t BUZZER_IDLE_HZ = 2000;
const int BUZZER_VOLUME = 50;         // % duty cycle; 50 drives a square wave as hard as it goes
const uint32_t BUZZER_DUTY = (1UL << BUZZER_RES) * BUZZER_VOLUME / 100;

bool buzzerOk = false;
const Note *seqNotes = NULL;          // sound being played, NULL when silent
uint8_t seqCount = 0, seqIndex = 0;
uint32_t noteEndsMs = 0;

void startNote(uint16_t hz, uint16_t ms) {
  if (hz == 0) {
    ledcWrite(BUZZER_PIN, 0);
  } else {
    ledcChangeFrequency(BUZZER_PIN, hz, BUZZER_RES);
    ledcWrite(BUZZER_PIN, BUZZER_DUTY);
  }
  noteEndsMs = millis() + ms;
}

// Starts a sound and returns immediately; updateBuzzer() walks the notes.
void playSound(int index) {
  if (!buzzerOk || index < 0 || index >= NUM_SOUNDS) return;
  seqNotes = SOUNDS[index].notes;
  seqCount = SOUNDS[index].count;
  seqIndex = 0;
  startNote(seqNotes[0].hz, seqNotes[0].ms);
}

// A single tone held briefly, for finding the piezo's loudest frequency.
Note adhocNote[1];
void playTone(int hz, int ms) {
  if (!buzzerOk || hz < 100 || hz > 20000) return;
  adhocNote[0].hz = (uint16_t)hz;
  adhocNote[0].ms = (uint16_t)ms;
  seqNotes = adhocNote;
  seqCount = 1;
  seqIndex = 0;
  startNote(adhocNote[0].hz, adhocNote[0].ms);
}

bool buzzerBusy() { return seqNotes != NULL; }

// Called from loop(): moves to the next note when the current one is done.
void updateBuzzer() {
  if (!seqNotes) return;
  if ((int32_t)(millis() - noteEndsMs) < 0) return;
  if (++seqIndex >= seqCount) {
    ledcWrite(BUZZER_PIN, 0);
    seqNotes = NULL;
    return;
  }
  startNote(seqNotes[seqIndex].hz, seqNotes[seqIndex].ms);
}

void printBuzzerInfo() {
  if (!buzzerOk) {
    Serial.printf("  buzzer: GPIO %d FAILED to take LEDC channel %d\n", BUZZER_PIN, BUZZER_CHANNEL);
    return;
  }
  ledc_channel_handle_t *bus = (ledc_channel_handle_t *)perimanGetPinBus(BUZZER_PIN, ESP32_BUS_TYPE_LEDC);
  Serial.printf("  buzzer: GPIO %d, LEDC ch %d (timer %d), sounds:", BUZZER_PIN, bus ? bus->channel : -1,
                bus ? bus->timer_num : -1);
  for (int i = 0; i < NUM_SOUNDS; i++) Serial.printf(" B%d=%s", i, SOUNDS[i].name);
  Serial.println();
}

void setupBuzzer() {
  buzzerOk = ledcAttachChannel(BUZZER_PIN, BUZZER_IDLE_HZ, BUZZER_RES, BUZZER_CHANNEL);
  if (buzzerOk) ledcWrite(BUZZER_PIN, 0);  // silent until a sound plays
  printBuzzerInfo();
}

// --- status LED --------------------------------------------------------
// The switch's LED ring, common anode to 5V, with an S8050 NPN sinking the
// cathode and its base on GPIO 16 through 330 ohm. The transistor doesn't
// invert the sense of the PWM: base high -> it conducts -> the LED lights,
// so duty 0 is off and full duty is full brightness.
//
// 12-bit at 5 kHz, deliberately different from the buzzer's 10 bits so the
// core hands it its own timer rather than sharing the buzzer's - a shared
// timer would change the LED's frequency every time a note changed pitch.
//
// The ring is a 12V part run at 5V, so full brightness may still look weak.
// That's a hardware limit (its internal resistor); nothing here tries to
// compensate for it.
const int LED_PIN = 16;
const uint8_t LED_CHANNEL = 6;       // asked for by number: servos 0-4, buzzer 5
const uint8_t LED_RES = 12;
const uint32_t LED_FREQ = 5000;      // well above flicker, easy on the transistor
const uint32_t LED_MAX = (1UL << LED_RES) - 1;

const uint32_t BREATHE_MS = 2000;    // one full fade up and back down
const uint32_t BLINK_ON_MS = 70;     // the double-blink's shape
const uint32_t BLINK_OFF_MS = 110;

bool ledOk = false;
bool ledAuto = true;                 // false once a serial command forces a state
bool ledSolid = false;               // the base state: solid on with a client connected
uint8_t blinkPhase = 0;              // 0 = idle, else steps left in the double-blink
uint32_t blinkNextMs = 0;
extern int wsClients;                // defined with the web server below

// Starts the double-blink and returns; updateLed() walks it and then drops
// straight back to whichever base state is current.
void blinkLed() {
  if (!ledOk) return;
  blinkPhase = 4;  // on, off, on, off
  blinkNextMs = millis();
}

// Called from loop(): never blocks, never delays. Recomputes the duty from
// the clock each pass, so a slow pass shows up as a slightly coarser fade
// and nothing else.
void updateLed() {
  if (!ledOk) return;
  if (ledAuto) ledSolid = (wsClients > 0);
  uint32_t now = millis();

  if (blinkPhase) {
    if ((int32_t)(now - blinkNextMs) < 0) return;
    bool on = (blinkPhase % 2) == 0;
    ledcWrite(LED_PIN, on ? LED_MAX : 0);
    blinkNextMs = now + (on ? BLINK_ON_MS : BLINK_OFF_MS);
    blinkPhase--;
    return;
  }

  if (ledSolid) {
    ledcWrite(LED_PIN, LED_MAX);
    return;
  }

  // Breathing: a raised cosine over BREATHE_MS, squared so the eye reads
  // the fade as even instead of rushing through the dim half.
  float phase = (now % BREATHE_MS) / (float)BREATHE_MS;
  float t = 0.5f * (1.0f - cosf(2.0f * PI * phase));
  ledcWrite(LED_PIN, (uint32_t)(t * t * LED_MAX));
}

void printLedInfo() {
  if (!ledOk) {
    Serial.printf("  status LED: GPIO %d FAILED to take LEDC channel %d\n", LED_PIN, LED_CHANNEL);
    return;
  }
  ledc_channel_handle_t *bus = (ledc_channel_handle_t *)perimanGetPinBus(LED_PIN, ESP32_BUS_TYPE_LEDC);
  Serial.printf("  status LED: GPIO %d, LEDC ch %d (timer %d), now %s, states: "
                "L0=breathe L1=solid L2=double-blink L3=auto\n",
                LED_PIN, bus ? bus->channel : -1, bus ? bus->timer_num : -1,
                !ledAuto ? (ledSolid ? "solid (forced)" : "breathing (forced)")
                         : (ledSolid ? "solid: client connected" : "breathing: no client"));
}

void setupLed() {
  ledOk = ledcAttachChannel(LED_PIN, LED_FREQ, LED_RES, LED_CHANNEL);
  if (ledOk) ledcWrite(LED_PIN, 0);  // dark until updateLed() takes over
  printLedInfo();
}

const uint32_t SERVO_FREQ = 50;      // Hz
const uint32_t PERIOD_US = 20000;    // 1 / 50 Hz
// 14 bits is the S3's LEDC maximum (ledcAttach rejects 16).
// At 50 Hz that's 20000 / 16384 = ~1.22 us per step.
const uint8_t SERVO_RES = 14;
static_assert(SERVO_RES <= SOC_LEDC_TIMER_BIT_WIDTH, "LEDC resolution too high for this chip");

// Same pulse range as the Arduino Servo library (544-2400us), so servo
// degrees mean the same physical positions they did on the Uno.
const int PULSE_MIN = 544;
const int PULSE_MAX = 2400;

// --- calibration -------------------------------------------------------
// The single per-finger calibration table: servo angle at fully open and
// at fully closed. openAngle > closedAngle means the linkage runs
// backwards - that's intended, don't normalize it. The finger is never
// driven outside [openAngle, closedAngle].
//
// Measured 2026-09-15 as slider % on the old desktop/hand_cal.json scale
// (start -> end), converted with angle = start + pct * (end - start).
struct FingerCal { int pin; int openAngle; int closedAngle; };

const int NUM_FINGERS = 5;
const FingerCal FINGERS[NUM_FINGERS] = {
  {4,  135,  10},  // Thumb:  0-100% of 135->10  (unchanged)
  {5,  144,   0},  // Index:  20-100% of 180->0
  {6,   36, 180},  // Middle: 20-100% of 0->180
  {7,   50, 154},  // Ring:   0-80% of 50->180 (past 154 over-rotates)
  {15,  16, 160},  // Pinky:  10-100% of 0->160
};

bool attachedOk[NUM_FINGERS];
float fingerPct[NUM_FINGERS];  // last commanded position, 0.0-1.0

// --- low level: only setFinger() calls these -------------------------
void writePulseUs(int pin, uint32_t pulse_us) {
  uint32_t duty = (pulse_us * (1UL << SERVO_RES)) / PERIOD_US;
  ledcWrite(pin, duty);
}

uint32_t angleToPulseUs(float angle) {
  float us = PULSE_MIN + angle * (PULSE_MAX - PULSE_MIN) / 180.0f;
  return (uint32_t)constrain(lroundf(us), (long)PULSE_MIN, (long)PULSE_MAX);
}

// The one way to move a finger. pct 0.0 = open, 1.0 = closed.
void setFinger(int index, float pct) {
  if (index < 0 || index >= NUM_FINGERS || isnan(pct)) return;
  pct = constrain(pct, 0.0f, 1.0f);
  const FingerCal &f = FINGERS[index];
  float angle = f.openAngle + pct * (f.closedAngle - f.openAngle);
  // Absolute clamp to the calibrated range, whichever way it runs.
  float lo = min(f.openAngle, f.closedAngle);
  float hi = max(f.openAngle, f.closedAngle);
  angle = constrain(angle, lo, hi);
  writePulseUs(f.pin, angleToPulseUs(angle));
  fingerPct[index] = pct;
}

// Stops pulses on every servo (limp). Commands no position; the channels
// stay attached and the next setFinger() drives the servo again.
void relaxAll() {
  for (int i = 0; i < NUM_FINGERS; i++) ledcWrite(FINGERS[i].pin, 0);
}

// --- startup animation -------------------------------------------------
// All timings in one place so they're easy to tune. Replay with "A".
const int FRAME_MS = 10;          // update interval while animating
const int OPEN_MOVE_MS = 300;     // 1. all fingers to open...
const int OPEN_HOLD_MS = 300;     //    ...then pause
const int CURL_STAGGER_MS = 150;  // 2. delay between each finger's start
const int CURL_MS = 350;          //    time for one finger's full curl
const int CLOSED_HOLD_MS = 250;   //    hold with the fist closed
const int UNCURL_HOLD_MS = 150;   // 3. pause after uncurling
const int WAVE_STAGGER_MS = 90;   // 4. ripple: delay between fingers
const int WAVE_MS = 500;          //    one finger's curl-and-back
const float WAVE_DEPTH = 1.0f;    //    how far each finger curls (0-1)
const int END_HOLD_MS = 400;      // 5. final hold, open

const int THUMB_TO_PINKY[NUM_FINGERS] = {0, 1, 2, 3, 4};
const int PINKY_TO_THUMB[NUM_FINGERS] = {4, 3, 2, 1, 0};

// Ease in and out: zero speed at both ends of a move.
float smoothstep(float t) {
  t = constrain(t, 0.0f, 1.0f);
  return t * t * (3.0f - 2.0f * t);
}

// Move the fingers, in `order`, from wherever they are to `target`.
// Each finger starts `staggerMs` after the previous one and takes
// `durMs` to arrive.
void rippleTo(const int order[], float target, int staggerMs, int durMs) {
  float from[NUM_FINGERS];
  for (int i = 0; i < NUM_FINGERS; i++) from[i] = fingerPct[i];
  int total = staggerMs * (NUM_FINGERS - 1) + durMs;
  uint32_t t0 = millis();
  while (true) {
    int t = millis() - t0;
    for (int k = 0; k < NUM_FINGERS; k++) {
      int f = order[k];
      float u = smoothstep((t - k * staggerMs) / (float)durMs);
      setFinger(f, from[f] + (target - from[f]) * u);
    }
    if (t >= total) break;
    delay(FRAME_MS);
  }
}

// Each finger curls to `depth` and back to open, starting `staggerMs`
// after the previous one, so the curls overlap into a ripple.
void waveOnce(const int order[], float depth, int staggerMs, int durMs) {
  int total = staggerMs * (NUM_FINGERS - 1) + durMs;
  uint32_t t0 = millis();
  while (true) {
    int t = millis() - t0;
    for (int k = 0; k < NUM_FINGERS; k++) {
      float u = constrain((t - k * staggerMs) / (float)durMs, 0.0f, 1.0f);
      setFinger(order[k], depth * 0.5f * (1.0f - cosf(2.0f * PI * u)));
    }
    if (t >= total) break;
    delay(FRAME_MS);
  }
}

void playStartupAnimation() {
  uint32_t start = millis();
  // 1. all fingers to fully open, pause
  rippleTo(THUMB_TO_PINKY, 0.0f, 0, OPEN_MOVE_MS);
  delay(OPEN_HOLD_MS);
  // 2. curl thumb through pinky, one after another, brief hold
  rippleTo(THUMB_TO_PINKY, 1.0f, CURL_STAGGER_MS, CURL_MS);
  delay(CLOSED_HOLD_MS);
  // 3. uncurl pinky back to thumb
  rippleTo(PINKY_TO_THUMB, 0.0f, CURL_STAGGER_MS, CURL_MS);
  delay(UNCURL_HOLD_MS);
  // 4. wave: overlapping curl-and-release, thumb to pinky
  waveOnce(THUMB_TO_PINKY, WAVE_DEPTH, WAVE_STAGGER_MS, WAVE_MS);
  // 5. all fully open and hold
  for (int i = 0; i < NUM_FINGERS; i++) setFinger(i, 0.0f);
  delay(END_HOLD_MS);
  Serial.printf("animation done in %lu ms\n", (unsigned long)(millis() - start));
}

// --- info --------------------------------------------------------------
// Calibration, the LEDC channel the core assigned, and which LEDC channel
// the GPIO matrix actually routes to the pin.
void printInfo() {
  Serial.println("hand ready");
  int channels[NUM_FINGERS];
  for (int i = 0; i < NUM_FINGERS; i++) {
    int pin = FINGERS[i].pin;
    ledc_channel_handle_t *bus = (ledc_channel_handle_t *)perimanGetPinBus(pin, ESP32_BUS_TYPE_LEDC);
    int sig = REG_READ(GPIO_FUNC0_OUT_SEL_CFG_REG + 4 * pin) & 0x1FF;
    channels[i] = bus ? bus->channel : -1;
    if (!attachedOk[i] || !bus) {
      Serial.printf("  finger %d: GPIO %2d NOT ATTACHED\n", i, pin);
      continue;
    }
    Serial.printf("  finger %d: GPIO %2d, open %3d -> closed %3d deg, LEDC ch %d (timer %d), routed: ",
                  i, pin, FINGERS[i].openAngle, FINGERS[i].closedAngle, bus->channel, bus->timer_num);
    if (sig >= LEDC_LS_SIG_OUT0_IDX && sig <= LEDC_LS_SIG_OUT7_IDX) {
      Serial.printf("LEDC ch %d\n", sig - LEDC_LS_SIG_OUT0_IDX);
    } else {
      Serial.printf("signal %d (not LEDC!)\n", sig);
    }
  }
  bool distinct = true;
  for (int i = 0; i < NUM_FINGERS; i++)
    for (int j = i + 1; j < NUM_FINGERS; j++)
      if (channels[i] < 0 || channels[i] == channels[j]) distinct = false;
  Serial.println(distinct ? "  all 5 channels distinct" : "  WARNING: channels missing or shared");
}

// --- WiFi / web UI -----------------------------------------------------
// The ESP32 runs its own access point (it never joins another network) and
// serves the web app over HTTPS with the websocket on the same origin: the
// camera needs a secure page, and a secure page can only open a secure
// websocket. Assets come pre-gzipped from LittleFS (upload_fs.sh).
//
//   https://192.168.4.1/   the app (esp_https_server, cert from make_certs.sh)
//   wss://192.168.4.1/ws   phone <-> hand:
//     phone -> ESP32: "p0,p1,p2,p3,p4"  % curled 0-100, thumb..pinky, at most
//                                        ~30 Hz, plus a keepalive every 500 ms
//                     "A"               replay the startup animation
//     ESP32 -> phone: "p0,p1,p2,p3,p4"  the hand's actual position: on
//                                        connect, after an animation, and
//                                        when the watchdog opens the hand
//   http://192.168.4.1/    answers phones' "is there internet?" checks,
//                          serves the CA certificate, redirects to https
//   DNS (port 53)          resolves those check hostnames to 192.168.4.1 so
//                          phones keep using this network
//
// The servers run on their own tasks, so their handlers only store the
// newest frame; loop() is the only place that moves servos.
//
// Hotspot name and password. The real password lives in wifi_secrets.h next
// to this file (gitignored); copy wifi_secrets.example.h to start one.
#if __has_include("wifi_secrets.h")
#include "wifi_secrets.h"
#endif
#ifndef HAND_AP_SSID
#define HAND_AP_SSID "JOES-HAND"
#endif
#ifndef HAND_AP_PASS
#define HAND_AP_PASS "change-me-please"  // WPA2 needs at least 8 characters
#endif
const char *AP_SSID = HAND_AP_SSID;
const char *AP_PASS = HAND_AP_PASS;
const char *FS_PARTITION = "ffat";   // the fatflash scheme's 12 MB data partition
const uint32_t WATCHDOG_MS = 2000;   // open the hand after this long without a phone message
const IPAddress AP_IP(192, 168, 4, 1);
const size_t FILE_CHUNK = 16384;     // static files are sent in chunks this big (buffer in PSRAM)

// Hostnames phones probe to decide whether a WiFi network has internet.
const char *const CONNECTIVITY_HOSTS[] = {
  "connectivitycheck.gstatic.com", "connectivitycheck.android.com", "clients3.google.com",  // Android
  "captive.apple.com", "www.apple.com", "www.appleiphonecell.com",                          // Apple
  "www.msftconnecttest.com",                                                                // Windows
};

// Names that point at the hand itself. The same A record exists in public DNS,
// so a phone gets 192.168.4.1 whether or not it asks this server.
const char *const LOCAL_NAMES[] = {"hand.joeprojects.com"};

httpd_handle_t httpsServer = NULL;   // :443 app + websocket
httpd_handle_t httpServer = NULL;    // :80 connectivity checks + redirect
AsyncUDP dnsUdp;
bool dnsOk = false;
bool fsOk = false;
const char *certSource = "built-in self-signed (192.168.4.1 only)";
size_t pageBytes = 0;                // index.html.gz
int wsClients = 0;

portMUX_TYPE wsMux = portMUX_INITIALIZER_UNLOCKED;
int wsFrame[NUM_FINGERS];            // newest frame from the phone, 0-100
volatile bool wsFrameNew = false;
volatile bool wsAnimRequested = false;
volatile bool wsRelaxRequested = false;
volatile uint32_t lastWsMs = 0;
bool wsHolding = false;              // phone has set the fingers since the last watchdog trip

void stateString(char *out, size_t n) {
  snprintf(out, n, "%ld,%ld,%ld,%ld,%ld",
           lroundf(fingerPct[0] * 100), lroundf(fingerPct[1] * 100), lroundf(fingerPct[2] * 100),
           lroundf(fingerPct[3] * 100), lroundf(fingerPct[4] * 100));
}

// Queues a text frame to one websocket client from any task. The server
// sends it later from its own task, so the frame and its text live on the
// heap until the send completes.
struct WsOutMsg { httpd_ws_frame_t frame; char text[32]; };
void wsSendAsync(int fd, const char *text) {
  WsOutMsg *m = (WsOutMsg *)calloc(1, sizeof(WsOutMsg));
  if (!m) return;
  strlcpy(m->text, text, sizeof m->text);
  m->frame.final = true;
  m->frame.type = HTTPD_WS_TYPE_TEXT;
  m->frame.payload = (uint8_t *)m->text;
  m->frame.len = strlen(m->text);
  if (httpd_ws_send_data_async(httpsServer, fd, &m->frame, [](esp_err_t, int, void *arg) { free(arg); }, m) != ESP_OK) {
    free(m);
  }
}

void broadcastState() {
  if (!httpsServer) return;
  char buf[32];
  stateString(buf, sizeof buf);
  int fds[8];
  size_t n = 8;
  if (httpd_get_client_list(httpsServer, &n, fds) != ESP_OK) return;
  for (size_t i = 0; i < n; i++) {
    if (httpd_ws_get_fd_info(httpsServer, fds[i]) == HTTPD_WS_CLIENT_WEBSOCKET) wsSendAsync(fds[i], buf);
  }
}

// Queues the animation. The chirp plays first - playStartupAnimation()
// runs to completion once started, so loop() couldn't step the notes
// during it, and the chirp has to be over before the fingers move.
bool animQueued = false;
void runAnimation() {
  playSound(SOUND_BOOT);
  animQueued = true;
}

// Runs the queued animation once the chirp has finished, then beeps twice.
// Drops phone frames that queued up during it and tells the phone the hand
// is open again.
void serviceAnimation() {
  if (!animQueued || buzzerBusy()) return;
  animQueued = false;
  playStartupAnimation();
  playSound(SOUND_DONE);
  blinkLed();  // double-blink, then back to breathing or solid
  wsFrameNew = false;
  broadcastState();
}

// A text message from the phone: "A", or five integers 0-100.
void handlePhoneText(const char *buf, size_t len) {
  if (strcmp(buf, "A") == 0) {
    lastWsMs = millis();
    wsAnimRequested = true;
    return;
  }
  if (strcmp(buf, "R") == 0) {  // limp until the next position arrives
    lastWsMs = millis();
    wsRelaxRequested = true;
    return;
  }
  int v[NUM_FINGERS], used = 0;
  if (sscanf(buf, "%d,%d,%d,%d,%d%n", &v[0], &v[1], &v[2], &v[3], &v[4], &used) != 5
      || used != (int)len) return;
  for (int i = 0; i < NUM_FINGERS; i++)
    if (v[i] < 0 || v[i] > 100) return;
  portENTER_CRITICAL(&wsMux);
  memcpy(wsFrame, v, sizeof wsFrame);
  wsFrameNew = true;
  lastWsMs = millis();
  portEXIT_CRITICAL(&wsMux);
}

esp_err_t wsHandler(httpd_req_t *req) {
  if (req->method == HTTP_GET) {
    // Handshake done. The hand's position is sent from scanWsClients() a
    // moment later: sending it here goes out before the handshake response,
    // so the browser never sees it.
    return ESP_OK;
  }
  httpd_ws_frame_t frame = {};
  if (httpd_ws_recv_frame(req, &frame, 0) != ESP_OK) return ESP_FAIL;  // header only: gets the length
  if (frame.len > 64) return ESP_FAIL;                                   // not one of ours: drop the client
  uint8_t buf[65];
  frame.payload = buf;
  if (frame.len && httpd_ws_recv_frame(req, &frame, frame.len) != ESP_OK) return ESP_FAIL;
  // only small, unfragmented text messages
  if (frame.type != HTTPD_WS_TYPE_TEXT || frame.fragmented || frame.len == 0 || frame.len > 31) return ESP_OK;
  buf[frame.len] = '\0';
  handlePhoneText((const char *)buf, frame.len);
  return ESP_OK;
}

const char *mimeFor(const String &path) {
  if (path.endsWith(".html")) return "text/html; charset=utf-8";
  if (path.endsWith(".js")) return "text/javascript";
  if (path.endsWith(".wasm")) return "application/wasm";
  if (path.endsWith(".json")) return "application/json";
  if (path.endsWith(".svg")) return "image/svg+xml";
  if (path.endsWith(".css")) return "text/css";
  return "application/octet-stream";
}

// Static files from LittleFS. Each is stored as <name>.gz and sent as-is
// with Content-Encoding: gzip; the browser unpacks it.
esp_err_t fileHandler(httpd_req_t *req) {
  String path(req->uri);
  int q = path.indexOf('?');
  if (q >= 0) path.remove(q);
  if (path.endsWith("/")) path += "index.html";
  File f;
  bool gz = false;
  // /private/ holds the TLS key and certificate: never served.
  if (fsOk && path.indexOf("..") < 0 && !path.startsWith("/private/")) {
    gz = LittleFS.exists(path + ".gz");
    f = LittleFS.open(gz ? path + ".gz" : path, "r");
  }
  if (!f || f.isDirectory()) {
    httpd_resp_send_err(req, HTTPD_404_NOT_FOUND, "not found");
    return ESP_OK;
  }
  httpd_resp_set_type(req, mimeFor(path));
  if (gz) httpd_resp_set_hdr(req, "Content-Encoding", "gzip");
  // MediaPipe files never change under the same name; the page, service
  // worker and manifest are rechecked so a new build gets picked up.
  httpd_resp_set_hdr(req, "Cache-Control",
                     path.startsWith("/mp/") ? "public, max-age=31536000, immutable" : "no-cache");
  uint8_t *buf = (uint8_t *)heap_caps_malloc(FILE_CHUNK, MALLOC_CAP_SPIRAM);
  if (!buf) {
    f.close();
    httpd_resp_send_500(req);
    return ESP_OK;
  }
  esp_err_t err = ESP_OK;
  size_t n;
  while ((n = f.read(buf, FILE_CHUNK)) > 0) {
    if ((err = httpd_resp_send_chunk(req, (const char *)buf, n)) != ESP_OK) break;
  }
  free(buf);
  f.close();
  if (err != ESP_OK) return ESP_FAIL;  // client went away: drop the connection
  return httpd_resp_send_chunk(req, NULL, 0);
}

// The local CA certificate, for installing on a phone so it trusts the hand.
esp_err_t caCertHandler(httpd_req_t *req) {
  httpd_resp_set_type(req, "application/x-x509-ca-cert");
  return httpd_resp_send(req, CA_CERT_PEM, HTTPD_RESP_USE_STRLEN);
}

// --- connectivity checks (port 80) ---
// Phones fetch these over plain HTTP to decide whether a network has
// internet; answering the way the real servers do keeps them on this one.
esp_err_t probeNoContent(httpd_req_t *req) {  // Android: /generate_204
  Serial.printf("captive: %s -> 204\n", req->uri);
  httpd_resp_set_status(req, "204 No Content");
  return httpd_resp_send(req, NULL, 0);
}

esp_err_t probeAppleSuccess(httpd_req_t *req) {  // Apple: /hotspot-detect.html
  Serial.printf("captive: %s -> Success\n", req->uri);
  httpd_resp_set_type(req, "text/html");
  return httpd_resp_sendstr(req, "<HTML><HEAD><TITLE>Success</TITLE></HEAD><BODY>Success</BODY></HTML>");
}

esp_err_t probeMicrosoft(httpd_req_t *req) {  // Windows: /connecttest.txt
  httpd_resp_set_type(req, "text/plain");
  return httpd_resp_sendstr(req, "Microsoft Connect Test");
}

esp_err_t redirectToHttps(httpd_req_t *req) {
  // Redirect to the host the phone asked for (hand.joeprojects.com, say), not
  // to the IP - otherwise the certificate wouldn't match the address.
  char host[64] = "192.168.4.1";
  size_t len = httpd_req_get_hdr_value_len(req, "Host");
  if (len > 0 && len < sizeof host) httpd_req_get_hdr_value_str(req, "Host", host, sizeof host);
  char *port = strchr(host, ':');
  if (port) *port = '\0';
  char location[96];
  snprintf(location, sizeof location, "https://%s/", host);
  httpd_resp_set_status(req, "302 Found");
  httpd_resp_set_hdr(req, "Location", location);  // sent before this returns
  return httpd_resp_send(req, NULL, 0);
}

// --- DNS (port 53) ---
bool resolvesHere(const char *name) {
  for (const char *h : CONNECTIVITY_HOSTS)
    if (strcasecmp(name, h) == 0) return true;
  for (const char *h : LOCAL_NAMES)
    if (strcasecmp(name, h) == 0) return true;
  return false;
}

// Answers A queries for the connectivity-check hostnames with 192.168.4.1,
// other record types for them with no records, and every other name with
// "no such domain" so apps fail fast instead of waiting.
void onDnsPacket(AsyncUDPPacket &p) {
  const uint8_t *q = p.data();
  size_t n = p.length();
  if (n < 12 || n > 512 || (q[2] & 0x80)) return;  // too short/long, or not a query
  if (((q[4] << 8) | q[5]) != 1) return;           // exactly one question
  char name[128];
  size_t nl = 0, pos = 12;
  while (pos < n && q[pos] != 0) {
    uint8_t label = q[pos++];
    if ((label & 0xC0) || pos + label > n || nl + label + 2 > sizeof name) return;
    if (nl) name[nl++] = '.';
    memcpy(name + nl, q + pos, label);
    nl += label;
    pos += label;
  }
  name[nl] = '\0';
  if (pos + 5 > n) return;
  uint16_t qtype = (q[pos + 1] << 8) | q[pos + 2];
  size_t qend = pos + 5;  // end label + type + class
  bool known = resolvesHere(name);

  uint8_t r[512 + 16];
  memcpy(r, q, qend);                // header + question
  r[2] = 0x84 | (q[2] & 0x01);       // response, authoritative, copy "recursion desired"
  r[3] = known ? 0x00 : 0x03;        // NOERROR, or NXDOMAIN
  r[6] = 0;
  r[7] = (known && qtype == 1) ? 1 : 0;
  r[8] = r[9] = r[10] = r[11] = 0;
  size_t len = qend;
  if (r[7]) {
    const uint8_t answer[] = {0xC0, 0x0C, 0x00, 0x01, 0x00, 0x01, 0x00, 0x00, 0x00, 0x3C,
                              0x00, 0x04, 192, 168, 4, 1};  // name ptr, A, IN, TTL 60 s, 192.168.4.1
    memcpy(r + len, answer, sizeof answer);
    len += sizeof answer;
    Serial.printf("dns: %s -> 192.168.4.1\n", name);
  }
  dnsUdp.writeTo(r, len, p.remoteIP(), p.remotePort());
}

// Reads a PEM file into a heap buffer. mbedTLS wants the length to include
// the terminating NUL.
char *readPemFile(const char *path, size_t *outLen) {
  File f = LittleFS.open(path, "r");
  if (!f || f.isDirectory()) return NULL;
  size_t n = f.size();
  if (n == 0 || n > 16384) { f.close(); return NULL; }
  char *buf = (char *)malloc(n + 1);
  if (!buf) { f.close(); return NULL; }
  size_t got = f.read((uint8_t *)buf, n);
  f.close();
  buf[got] = '\0';
  *outLen = got + 1;
  return buf;
}

void addRoute(httpd_handle_t server, const char *uri, esp_err_t (*handler)(httpd_req_t *), bool websocket) {
  httpd_uri_t u = {};
  u.uri = uri;
  u.method = HTTP_GET;
  u.handler = handler;
  u.is_websocket = websocket;
  httpd_register_uri_handler(server, &u);
}

void onWiFiEvent(WiFiEvent_t event, WiFiEventInfo_t info) {
  switch (event) {
    case ARDUINO_EVENT_WIFI_AP_STACONNECTED: {
      const uint8_t *m = info.wifi_ap_staconnected.mac;
      Serial.printf("wifi: device %02x:%02x:%02x:%02x:%02x:%02x joined\n", m[0], m[1], m[2], m[3], m[4], m[5]);
      break;
    }
    case ARDUINO_EVENT_WIFI_AP_STAIPASSIGNED:
      Serial.printf("wifi: gave out %s\n", IPAddress(info.wifi_ap_staipassigned.ip.addr).toString().c_str());
      break;
    case ARDUINO_EVENT_WIFI_AP_STADISCONNECTED: {
      const uint8_t *m = info.wifi_ap_stadisconnected.mac;
      Serial.printf("wifi: device %02x:%02x:%02x:%02x:%02x:%02x left\n", m[0], m[1], m[2], m[3], m[4], m[5]);
      break;
    }
    default:
      break;
  }
}

// Prints websocket clients coming and going (called from loop()).
void scanWsClients() {
  static int known[8];
  static int nKnown = 0;
  int now[8], nNow = 0;
  if (httpsServer) {
    int fds[8];
    size_t n = 8;
    if (httpd_get_client_list(httpsServer, &n, fds) == ESP_OK) {
      for (size_t i = 0; i < n && nNow < 8; i++)
        if (httpd_ws_get_fd_info(httpsServer, fds[i]) == HTTPD_WS_CLIENT_WEBSOCKET) now[nNow++] = fds[i];
    }
  }
  auto has = [](const int *list, int count, int fd) {
    for (int i = 0; i < count; i++)
      if (list[i] == fd) return true;
    return false;
  };
  char state[32];
  stateString(state, sizeof state);
  for (int i = 0; i < nNow; i++)
    if (!has(known, nKnown, now[i])) {
      Serial.printf("ws: client connected (socket %d, %d connected, %u KB internal RAM free)\n", now[i], nNow,
                    (unsigned)(heap_caps_get_free_size(MALLOC_CAP_INTERNAL) / 1024));
      wsSendAsync(now[i], state);  // tell it where the fingers are
      playSound(SOUND_CLIENT);
    }
  for (int i = 0; i < nKnown; i++)
    if (!has(now, nNow, known[i])) Serial.printf("ws: client disconnected (socket %d)\n", known[i]);
  memcpy(known, now, sizeof now);
  nKnown = nNow;
  wsClients = nNow;
}

void printNetworkStatus() {
  wifi_config_t cfg;
  esp_wifi_get_config(WIFI_IF_AP, &cfg);
  Serial.printf("wifi: AP \"%s\" %s, %s, channel %d, IP %s, %d device(s) joined, station mode %s\n",
                AP_SSID, (WiFi.getMode() & WIFI_AP) ? "up" : "DOWN",
                cfg.ap.authmode == WIFI_AUTH_WPA2_PSK ? "WPA2-PSK" : "NOT WPA2",
                cfg.ap.channel, WiFi.softAPIP().toString().c_str(), WiFi.softAPgetStationNum(),
                (WiFi.getMode() & WIFI_STA) ? "ON (unexpected!)" : "off");
  Serial.printf("web: https :443 %s, http :80 %s, dns :53 %s\n", httpsServer ? "up" : "FAILED",
                httpServer ? "up" : "FAILED", dnsOk ? "up" : "FAILED");
  Serial.printf("tls: certificate %s | local name: %s\n", certSource, LOCAL_NAMES[0]);
  if (fsOk) {
    Serial.printf("fs: LittleFS on '%s' mounted, %u of %u KB used, index.html.gz %s\n", FS_PARTITION,
                  (unsigned)(LittleFS.usedBytes() / 1024), (unsigned)(LittleFS.totalBytes() / 1024),
                  pageBytes ? (String(pageBytes) + " bytes").c_str() : "MISSING - run upload_fs.sh");
  } else {
    Serial.printf("fs: LittleFS mount on '%s' FAILED - run upload_fs.sh\n", FS_PARTITION);
  }
  Serial.printf("ws: %d client(s), watchdog %s | free: %u KB internal RAM, %u KB PSRAM\n", wsClients,
                wsHolding ? "armed" : "idle", (unsigned)(heap_caps_get_free_size(MALLOC_CAP_INTERNAL) / 1024),
                (unsigned)(heap_caps_get_free_size(MALLOC_CAP_SPIRAM) / 1024));
}

void startNetwork() {
  WiFi.persistent(false);  // don't store WiFi settings in flash
  WiFi.onEvent(onWiFiEvent);
  WiFi.mode(WIFI_AP);      // access point only: never joins another network
  if (!WiFi.softAP(AP_SSID, AP_PASS, 1, 0, 4, false, WIFI_AUTH_WPA2_PSK, WIFI_CIPHER_TYPE_CCMP)) {
    Serial.println("wifi: softAP FAILED to start");
  }
  // DHCP tells phones to use the hand itself for DNS, so their connectivity
  // checks come here (see onDnsPacket).
  WiFi.softAPConfig(AP_IP, AP_IP, IPAddress(255, 255, 255, 0), IPAddress((uint32_t)0), AP_IP);

  fsOk = LittleFS.begin(false, "/littlefs", 10, FS_PARTITION);
  if (fsOk) {
    File f = LittleFS.open("/index.html.gz", "r");
    if (f) {
      pageBytes = f.size();
      f.close();
    }
  }

  // HTTPS on 443: the app and the websocket. A real certificate from flash
  // (upload_fs.sh copies certs/live/*.pem to /private/) is used when it's
  // there, so renewing one never needs a firmware rebuild; otherwise the
  // self-signed pair compiled in from make_certs.sh.
  const char *certPem = SERVER_CERT_PEM;
  const char *keyPem = SERVER_KEY_PEM;
  size_t certLen = sizeof(SERVER_CERT_PEM), keyLen = sizeof(SERVER_KEY_PEM);
  if (fsOk) {
    size_t cLen = 0, kLen = 0;
    char *cert = readPemFile("/private/cert.pem", &cLen);
    char *key = readPemFile("/private/key.pem", &kLen);
    if (cert && key) {
      certPem = cert;
      keyPem = key;
      certLen = cLen;
      keyLen = kLen;
      certSource = "from flash (/private/cert.pem)";
    } else {
      free(cert);
      free(key);
    }
  }
  httpd_ssl_config_t ssl = HTTPD_SSL_CONFIG_DEFAULT();
  ssl.servercert = (const uint8_t *)certPem;
  ssl.servercert_len = certLen;
  ssl.prvtkey_pem = (const uint8_t *)keyPem;
  ssl.prvtkey_len = keyLen;
  ssl.httpd.uri_match_fn = httpd_uri_match_wildcard;
  ssl.httpd.max_uri_handlers = 4;
  if (httpd_ssl_start(&httpsServer, &ssl) == ESP_OK) {
    addRoute(httpsServer, "/ws", wsHandler, true);
    addRoute(httpsServer, "/joebotics-ca.crt", caCertHandler, false);
    addRoute(httpsServer, "/*", fileHandler, false);
  } else {
    httpsServer = NULL;
  }

  // HTTP on 80: connectivity checks, the CA certificate, redirect to https.
  httpd_config_t cfg = HTTPD_DEFAULT_CONFIG();
  cfg.server_port = 80;
  cfg.ctrl_port = ESP_HTTPD_DEF_CTRL_PORT;  // the https server uses the next port up
  cfg.uri_match_fn = httpd_uri_match_wildcard;
  cfg.max_uri_handlers = 8;
  cfg.max_open_sockets = 3;
  cfg.lru_purge_enable = true;
  if (httpd_start(&httpServer, &cfg) == ESP_OK) {
    addRoute(httpServer, "/generate_204", probeNoContent, false);
    addRoute(httpServer, "/gen_204", probeNoContent, false);
    addRoute(httpServer, "/hotspot-detect.html", probeAppleSuccess, false);
    addRoute(httpServer, "/library/test/success.html", probeAppleSuccess, false);
    addRoute(httpServer, "/connecttest.txt", probeMicrosoft, false);
    addRoute(httpServer, "/joebotics-ca.crt", caCertHandler, false);
    addRoute(httpServer, "/*", redirectToHttps, false);
  } else {
    httpServer = NULL;
  }

  dnsOk = dnsUdp.listen(53);
  if (dnsOk) dnsUdp.onPacket(onDnsPacket);

  printNetworkStatus();
  Serial.println("web: open https://192.168.4.1/ (websocket wss://192.168.4.1/ws)");
}

// Every LEDC user in one table, so a shared channel or a doubled-up pin is
// obvious at boot instead of showing up as two peripherals fighting. Lives
// down here because it reads the finger table defined above.
void printChannelMap() {
  const char *names[] = {"thumb", "index", "middle", "ring", "pinky", "buzzer", "status LED"};
  const int pins[] = {FINGERS[0].pin, FINGERS[1].pin, FINGERS[2].pin, FINGERS[3].pin,
                      FINGERS[4].pin, BUZZER_PIN, LED_PIN};
  // Configured, not measured: ledcReadFreq() returns 0 for any channel
  // sitting at duty 0, which is most of them most of the time. The buzzer's
  // moves with each note; this is the frequency it idles at.
  const uint32_t freqs[] = {SERVO_FREQ, SERVO_FREQ, SERVO_FREQ, SERVO_FREQ, SERVO_FREQ,
                            BUZZER_IDLE_HZ, LED_FREQ};
  const int n = sizeof(pins) / sizeof(pins[0]);
  int ch[n];

  Serial.printf("LEDC channel map (%d of %d channels used):\n", n, SOC_LEDC_CHANNEL_NUM);
  for (int i = 0; i < n; i++) {
    ledc_channel_handle_t *bus = (ledc_channel_handle_t *)perimanGetPinBus(pins[i], ESP32_BUS_TYPE_LEDC);
    ch[i] = bus ? bus->channel : -1;
    if (!bus) {
      Serial.printf("  ch  -  %-10s GPIO %2d  NOT ATTACHED\n", names[i], pins[i]);
      continue;
    }
    Serial.printf("  ch %d  %-10s GPIO %2d  timer %d, %u Hz, %d-bit\n", bus->channel, names[i],
                  pins[i], bus->timer_num, (unsigned)freqs[i], bus->channel_resolution);
  }

  bool clash = false;
  for (int i = 0; i < n; i++) {
    if (ch[i] < 0) clash = true;
    for (int j = i + 1; j < n; j++)
      if (ch[i] == ch[j] || pins[i] == pins[j]) clash = true;
  }
  if (clash) {
    Serial.println("  WARNING: a channel is shared, missing, or two peripherals are on one pin");
  } else {
    Serial.printf("  no collisions: %d peripherals, %d distinct channels, %d spare\n", n, n,
                  SOC_LEDC_CHANNEL_NUM - n);
  }
}

void setup() {
  Serial.begin(115200);
  // Attach all five permanently and drive each straight to open. A fresh
  // channel outputs no pulses until the first write, so the first pulse
  // each servo sees is its open position.
  for (int i = 0; i < NUM_FINGERS; i++) {
    attachedOk[i] = ledcAttach(FINGERS[i].pin, SERVO_FREQ, SERVO_RES);
    if (attachedOk[i]) setFinger(i, 0.0f);
  }
  printInfo();
  setupBuzzer();
  setupLed();
  printChannelMap();
  startNetwork();
  runAnimation();  // chirp first, then the fingers - both advanced from loop()
}

// Serial protocol:
//   "2:37.5\n" -> finger 2 (middle) to 37.5% curled (0 = open, 100 = closed)
//   "A\n"      -> replay the startup animation
//   "R\n"      -> relax: stop pulses on all servos (limp)
//   "?\n"      -> print calibration, LEDC channels, routing and network status
//   "B0\n"     -> play a sound: B0 boot chirp, B1 done beep, B2 client blip,
//                 B3 sweep 1-5 kHz. "B3000" holds 3000 Hz for 400 ms, to
//                 find which frequency is loudest on this piezo.
//   "L0\n"     -> force the status LED: L0 breathe, L1 solid, L2 double-blink,
//                 L3 back to automatic (breathe idle, solid with a client)
void handleSerial() {
  String line = Serial.readStringUntil('\n');
  line.trim();

  if (line == "A") {
    runAnimation();
    return;
  }
  if (line == "R") {
    relaxAll();
    Serial.println("relaxed");
    return;
  }
  if (line == "?") {
    printInfo();
    printBuzzerInfo();
    printLedInfo();
    printChannelMap();
    printNetworkStatus();
    return;
  }
  if (line.startsWith("L")) {
    int n = line.substring(1).toInt();
    if (n == 0 || n == 1) {
      ledAuto = false;
      ledSolid = (n == 1);
      Serial.printf("led: forced %s\n", ledSolid ? "solid" : "breathing");
    } else if (n == 2) {
      blinkLed();
      Serial.println("led: double-blink");
    } else if (n == 3) {
      ledAuto = true;
      Serial.println("led: automatic (breathe idle, solid with a client)");
    }
    return;
  }
  if (line.startsWith("B")) {
    int n = line.substring(1).toInt();
    if (n >= 100) {  // a frequency, not a sound index
      playTone(n, 400);
      Serial.printf("buzzer: %d Hz\n", n);
    } else if (n >= 0 && n < NUM_SOUNDS) {
      playSound(n);
      Serial.printf("buzzer: %s\n", SOUNDS[n].name);
    }
    return;
  }

  int colon = line.indexOf(':');
  if (colon <= 0) return;
  int idx = line.substring(0, colon).toInt();
  float pct = line.substring(colon + 1).toFloat();
  setFinger(idx, pct / 100.0f);
}

void loop() {
  if (Serial.available()) handleSerial();

  // Newest phone frame -> fingers.
  if (wsFrameNew) {
    int v[NUM_FINGERS];
    portENTER_CRITICAL(&wsMux);
    memcpy(v, wsFrame, sizeof v);
    wsFrameNew = false;
    portEXIT_CRITICAL(&wsMux);
    for (int i = 0; i < NUM_FINGERS; i++) setFinger(i, v[i] / 100.0f);
    wsHolding = true;
  }

  if (wsAnimRequested) {
    wsAnimRequested = false;
    runAnimation();
  }

  updateLed();         // breathe / solid / blink; never blocks
  updateBuzzer();      // steps the current sound; never blocks
  serviceAnimation();  // starts the queued animation once the chirp is done

  // Limp: stop pulses and disarm the watchdog, so it doesn't drive the
  // fingers back open two seconds later. The next position wakes them.
  if (wsRelaxRequested) {
    wsRelaxRequested = false;
    relaxAll();
    wsHolding = false;
    Serial.println("phone: limp (servos off until the next position)");
  }

  // Watchdog: the phone sends at least every 500 ms while its page is
  // open. If it goes quiet for 2 s (locked, backgrounded, out of range,
  // or the socket dropped), open the hand instead of freezing mid-grip.
  // Read lastWsMs before millis() so a message landing in between can't
  // make the difference wrap around.
  uint32_t last = lastWsMs;
  if (wsHolding && millis() - last > WATCHDOG_MS) {
    wsHolding = false;
    for (int i = 0; i < NUM_FINGERS; i++) setFinger(i, 0.0f);
    Serial.println("watchdog: no phone message for 2 s -> all fingers open");
    broadcastState();
  }

  static uint32_t lastScan = 0;
  if (millis() - lastScan > 500) {
    lastScan = millis();
    scanWsClients();
  }
  delay(1);
}
